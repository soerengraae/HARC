## debug_build/Kconfig/boards/Kconfig
```kconfig
# Load Zephyr board Kconfig descriptions.
osource "C:/Users/sgraae/zephyrproject/zephyr/boards/nordic/nrf52dk/Kconfig"
```

## debug_build/Kconfig/boards/Kconfig.defconfig
```kconfig
# Load Zephyr board defconfig descriptions.
osource "C:/Users/sgraae/zephyrproject/zephyr/boards/nordic/nrf52dk/Kconfig.defconfig"
```

## debug_build/Kconfig/boards/Kconfig.nrf52dk
```kconfig
# Load board Kconfig descriptions.
osource "C:/Users/sgraae/zephyrproject/zephyr/boards/nordic/nrf52dk/Kconfig.nrf52dk"
```

## debug_build/Kconfig/boards/Kconfig.sysbuild
```kconfig
# Load Sysbuild board Kconfig descriptions.
osource "C:/Users/sgraae/zephyrproject/zephyr/boards/nordic/nrf52dk/Kconfig.sysbuild"
```
