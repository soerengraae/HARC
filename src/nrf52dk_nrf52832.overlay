&i2c0 {
    status = "okay";
    sda-pin = <26>;
    scl-pin = <27>;
    
    ssd1306: ssd1306@3c {
        compatible = "solomon,ssd1306fb";
        reg = <0x3c>;
        width = <128>;
        height = <64>;
        segment-offset = <0>;
        page-offset = <0>;
        display-offset = <0>;
        multiplex-ratio = <63>;
        segment-remap;
        com-invdir;
        prechargep = <0x22>;
    };
};
```

### **B) Update prj.conf**
Add these lines to your `prj.conf` file:
```
# I2C Support
CONFIG_I2C=y

# Display Support
CONFIG_DISPLAY=y
CONFIG_SSD1306=y

# Character Frame Buffer for text rendering
CONFIG_CHARACTER_FRAMEBUFFER=y

# Increase main stack
CONFIG_MAIN_STACK_SIZE=4096